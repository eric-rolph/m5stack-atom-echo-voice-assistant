## platformio-espidf/sdkconfig.defaults
```kconfig
# ESP32 Configuration
CONFIG_ESP32_DEFAULT_CPU_FREQ_240=y
CONFIG_ESP32_DEFAULT_CPU_FREQ_MHZ=240

# FreeRTOS
CONFIG_FREERTOS_HZ=1000
CONFIG_FREERTOS_UNICORE=n

# WiFi
CONFIG_ESP32_WIFI_STATIC_RX_BUFFER_NUM=10
CONFIG_ESP32_WIFI_DYNAMIC_RX_BUFFER_NUM=32
CONFIG_ESP32_WIFI_DYNAMIC_TX_BUFFER_NUM=32

# LWIP
CONFIG_LWIP_MAX_SOCKETS=10
CONFIG_LWIP_SO_REUSE=y
CONFIG_LWIP_SO_RCVBUF=y

# mbedTLS
CONFIG_MBEDTLS_SSL_MAX_CONTENT_LEN=16384
CONFIG_MBEDTLS_CERTIFICATE_BUNDLE=y
CONFIG_MBEDTLS_CERTIFICATE_BUNDLE_DEFAULT_FULL=y

# ESP HTTP Client
CONFIG_ESP_HTTP_CLIENT_ENABLE_HTTPS=y

# WebSocket
CONFIG_WS_TRANSPORT=y
CONFIG_WS_BUFFER_SIZE=2048

# I2S
CONFIG_I2S_ENABLE_DEBUG_LOG=n

# Log levels
CONFIG_LOG_DEFAULT_LEVEL_INFO=y
CONFIG_LOG_MAXIMUM_LEVEL_VERBOSE=y

# Component config
CONFIG_ESP_TASK_WDT_TIMEOUT_S=10

# Main task stack size (increase for HTTP client + Base64 encoding)
CONFIG_ESP_MAIN_TASK_STACK_SIZE=24576
```
