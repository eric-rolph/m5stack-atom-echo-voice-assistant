## main/Kconfig.projbuild
```kconfig
menu "M5Stack ATOM Echo Configuration"

    config WIFI_SSID
        string "WiFi SSID"
        default "myssid"
        help
            WiFi SSID to connect to.

    config WIFI_PASSWORD
        string "WiFi Password"
        default "mypassword"
        help
            WiFi password to connect to.

    config OPENAI_API_KEY
        string "OpenAI API Key"
        default ""
        help
            Your OpenAI API Key for the Realtime API.

endmenu
```

## sdkconfig.defaults
```kconfig
# Memory Optimization for ESP32-PICO-D4 (No PSRAM)
CONFIG_ESP32_WIFI_DYNAMIC_RX_BUFFER_NUM=16
CONFIG_ESP32_WIFI_DYNAMIC_TX_BUFFER_NUM=16
CONFIG_ESP32_WIFI_STATIC_RX_BUFFER_NUM=4
CONFIG_ESP32_WIFI_TX_BUFFER_TYPE=1
CONFIG_MBEDTLS_DYNAMIC_BUFFER=y
CONFIG_MBEDTLS_DYNAMIC_FREE_PEER_CERTIFICATE=y
CONFIG_MBEDTLS_DYNAMIC_FREE_CONFIG_DATA=y
CONFIG_MBEDTLS_CERTIFICATE_BUNDLE=y
CONFIG_MBEDTLS_CERTIFICATE_BUNDLE_DEFAULT_FULL=y

# FreeRTOS Tick Rate
CONFIG_FREERTOS_HZ=1000

# WebSocket config
CONFIG_WS_DYNAMIC_BUFFER=y
CONFIG_WS_BUFFER_SIZE=8192
```
